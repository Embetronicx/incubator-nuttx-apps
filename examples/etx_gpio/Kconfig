## examples/etx_gpio/Kconfig
```kconfig
#
# For a description of the syntax of this configuration file,
# see the file kconfig-language.txt in the NuttX tools repository.
#

config EXAMPLES_ETX_GPIO
	tristate "EmbeTronicX GPIO app example"
	default n
	depends on ESP32_ETX_GPIO
	---help---
		Enable the EmbeTronicX GPIO app example

if EXAMPLES_ETX_GPIO

config EXAMPLES_ETX_GPIO_PROGNAME
	string "Program name"
	default "etx_gpio"
	---help---
		This is the name of the program that will be used when the NSH ELF
		program is installed.

config EXAMPLES_ETX_GPIO_PRIORITY
	int "etx_gpio task priority"
	default 100

config EXAMPLES_ETX_GPIO_STACKSIZE
	int "etx_gpio stack size"
	default DEFAULT_TASK_STACKSIZE

endif
```

## examples/etx_i2c/Kconfig
```kconfig
#
# For a description of the syntax of this configuration file,
# see the file kconfig-language.txt in the NuttX tools repository.
#

config EXAMPLES_ETX_I2C_ACCEL
	tristate "EmbeTronicX I2C app examples (ADXL345 Accelerometer)"
	default n
	depends on I2C && I2C_DRIVER
	---help---
		Enable the EmbeTronicX I2C app examples (ADXL345 Accelerometer)

if EXAMPLES_ETX_I2C_ACCEL

config EXAMPLES_ETX_I2C_ACCEL_DATA
	tristate "EmbeTronicX ADXL345 Accelerometer data (x, Y, Z) read"
	default n
	depends on EXAMPLES_ETX_I2C_ACCEL
	---help---
		Enable the EmbeTronicX ADXL345 Accelerometer apps  that reads the data
		X, Y, Z axis continuously.

if EXAMPLES_ETX_I2C_ACCEL_DATA

config EXAMPLES_ETX_I2C_ACCEL_PROGNAME
	string "Program name"
	default "etx_i2c_adxl345"
	---help---
		This is the name of the program that will be used when the NSH ELF
		program is installed.
	
endif
	
config EXAMPLES_ETX_I2C_ACCEL_TAP
	tristate "EmbeTronicX ADXL345 Accelerometer Tap detection"
	default n
	depends on EXAMPLES_ETX_I2C_ACCEL
	---help---
		Enable the EmbeTronicX ADXL345 Accelerometer app that detects the single tap
		and double tap continuously.

if EXAMPLES_ETX_I2C_ACCEL_TAP

config EXAMPLES_ETX_I2C_ACCEL_TAP_PROGNAME
	string "Program name"
	default "etx_i2c_adxl345_tap"
	---help---
		This is the name of the program that will be used when the NSH ELF
		program is installed.
	
endif

if EXAMPLES_ETX_I2C_ACCEL_TAP || EXAMPLES_ETX_I2C_ACCEL_DATA

config EXAMPLES_ETX_I2C_ACCEL_PRIORITY
	int "etx_i2c_adxl345 task priority"
	default 100

config EXAMPLES_ETX_I2C_ACCEL_STACKSIZE
	int "etx_i2c_adx345 stack size"
	default DEFAULT_TASK_STACKSIZE
endif

endif
```

## examples/etx_led/Kconfig
```kconfig
#
# For a description of the syntax of this configuration file,
# see the file kconfig-language.txt in the NuttX tools repository.
#

comment "Applications added by EmbeTronicX (www.embetronicx.com)"

config EXAMPLES_ETX_LED
	tristate "EmbeTronicX LED app example"
	default n
	depends on ESP32_ETX_LED
	---help---
		Enable the EmbeTronicX LED app example

if EXAMPLES_ETX_LED

config EXAMPLES_ETX_LED_PROGNAME
	string "Program name"
	default "etx_led"
	---help---
		This is the name of the program that will be used when the NSH ELF
		program is installed.

config EXAMPLES_ETX_LED_PRIORITY
	int "etx_led task priority"
	default 100

config EXAMPLES_ETX_LED_STACKSIZE
	int "etx_led stack size"
	default DEFAULT_TASK_STACKSIZE

endif
```

## examples/etx_spi/Kconfig
```kconfig
#
# For a description of the syntax of this configuration file,
# see the file kconfig-language.txt in the NuttX tools repository.
#

config EXAMPLES_ETX_SPI_SSD1306_APP
	tristate "EmbeTronicX SSD1306 OLED App"
	default n
	depends on ESP32_ETX_SPI && ESP32_ETX_GPIO
	---help---
		Enable the EmbeTronicX SSD1306 OLED app that write the text,
		Image to the OLED Display.

config EXAMPLES_ETX_SPI_SSD1306_APP_PROGNAME
	string "Program name"
	default "etx_spi_oled"
	depends on EXAMPLES_ETX_SPI_SSD1306_APP
	---help---
		This is the name of the program that will be used when the NSH ELF
		program is installed.

config EXAMPLES_ETX_SPI_SSD1306_APP_PRIORITY
	int "etx_spi_oled task priority"
	default 100
	depends on EXAMPLES_ETX_SPI_SSD1306_APP

config EXAMPLES_ETX_SPI_SSD1306_APP_STACKSIZE
	int "etx_spi_oled stack size"
	default DEFAULT_TASK_STACKSIZE
	depends on EXAMPLES_ETX_SPI_SSD1306_APP
	
config EXAMPLES_ETX_SPI_SSD1306_RST_PIN
	int "SSD1306 Reset Pin number"
	default 18
	range 0 39
	depends on EXAMPLES_ETX_SPI_SSD1306_APP

config EXAMPLES_ETX_SPI_SSD1306_DC_PIN
	int "SSD1306 Data/Command Pin number"
	default 19
	range 0 39
	depends on EXAMPLES_ETX_SPI_SSD1306_APP
	
```
